## firmware/boards/elecrow_p4_lcd_7/sdkconfig.defaults
```kconfig
# SPDX-License-Identifier: GPL-3.0-or-later
# Board-specific Kconfig defaults for Elecrow CrowPanel Advanced 7" ESP32-P4.
# Targets v1.x production silicon (esptool reports rev v1.3).

# ----- v1.x silicon compatibility -----
# ESP32P4_REV_MIN_100 depends on ESP32P4_SELECTS_REV_LESS_V3; must enable that first.
CONFIG_ESP32P4_SELECTS_REV_LESS_V3=y
CONFIG_ESP32P4_REV_MIN_100=y

# ----- Flash (16 MB) -----
CONFIG_ESPTOOLPY_FLASHSIZE_16MB=y
CONFIG_PARTITION_TABLE_CUSTOM_FILENAME="partitions/16M.csv"

# ----- CPU: 360 MHz (safe for v1.x; 400 MHz requires v3.x) -----
CONFIG_ESP_DEFAULT_CPU_FREQ_MHZ_360=y

# ----- PSRAM: 32 MB hex-PSRAM, 16-line mode -----
# 250 MHz requires v3.x silicon; 200 MHz is the max for v1.x.
CONFIG_SPIRAM=y
CONFIG_SPIRAM_SPEED_200M=y

# ----- DSI display -----
CONFIG_LCD_DSI_ISR_HANDLER_IN_IRAM=y
CONFIG_LCD_DSI_OBJ_FORCE_INTERNAL=y

# ----- LVGL: disable Xtensa/ARM-specific optimizations (P4 is RISC-V) -----
CONFIG_LV_USE_DRAW_ARM2D_SYNC=n
CONFIG_LV_USE_NATIVE_HELIUM_ASM=n

# ----- v1.x has no ECDSA hardware peripheral -----
# Without this, mbedTLS logs errors on every TLS handshake.
CONFIG_MBEDTLS_HARDWARE_ECDSA_SIGN=n
CONFIG_MBEDTLS_HARDWARE_ECDSA_VERIFY=n

# ----- Host transport: native USB via USB-OTG -----
CONFIG_TOUCHY_LOG_OVER_PROTO=y
```

## firmware/boards/elecrow_s3_lcd_7_adv/sdkconfig.defaults
```kconfig
# SPDX-License-Identifier: GPL-3.0-or-later
# Board-specific Kconfig defaults for Elecrow ESP32-S3 7" Advance (v1.0, v1.2).
# I2C is on GPIO15/16, leaving GPIO19/20 (USB D+/D-) free for native USB HID.
# Module: ESP32-S3-WROOM-1-N16R8 (16 MB flash, 8 MB octal PSRAM).

# ----- Flash (4 MB active, QIO @ 80 MHz; board has 16 MB but 4 MB partition suffices) -----
CONFIG_ESPTOOLPY_FLASHSIZE_4MB=y
CONFIG_ESPTOOLPY_FLASHMODE_QIO=y
CONFIG_ESPTOOLPY_FLASHFREQ_80M=y
CONFIG_PARTITION_TABLE_CUSTOM_FILENAME="partitions/4M.csv"

# ----- PSRAM (8 MB, octal SPI @ 80 MHz) -----
CONFIG_SPIRAM=y
CONFIG_SPIRAM_MODE_OCT=y
CONFIG_SPIRAM_SPEED_80M=y
CONFIG_SPIRAM_FETCH_INSTRUCTIONS=y
CONFIG_SPIRAM_RODATA=y
CONFIG_ESP32S3_DATA_CACHE_LINE_64B=y

# ----- Host transport: native USB (vendor bulk + HID) -----
# I2C is on GPIO15/16, leaving GPIO19/20 (USB D+/D-) free.
CONFIG_TOUCHY_LOG_OVER_PROTO=y
```

## firmware/boards/squixl/sdkconfig.defaults
```kconfig
# SPDX-License-Identifier: GPL-3.0-or-later
# Board-specific Kconfig defaults for the SQUiXL (Unexpected Maker).
# Module: ESP32-S3 with 16 MB QIO flash, 8 MB octal PSRAM.
# I2C is on GPIO1/2, leaving GPIO19/20 (USB D+/D-) free for native USB.

# ----- Flash (16 MB, QIO @ 80 MHz) -----
CONFIG_ESPTOOLPY_FLASHSIZE_16MB=y
CONFIG_ESPTOOLPY_FLASHMODE_QIO=y
CONFIG_ESPTOOLPY_FLASHFREQ_80M=y
CONFIG_PARTITION_TABLE_CUSTOM_FILENAME="partitions/16M.csv"

# ----- PSRAM (8 MB, octal SPI @ 80 MHz) -----
CONFIG_SPIRAM=y
CONFIG_SPIRAM_MODE_OCT=y
CONFIG_SPIRAM_SPEED_80M=y
CONFIG_SPIRAM_FETCH_INSTRUCTIONS=y
CONFIG_SPIRAM_RODATA=y
CONFIG_ESP32S3_DATA_CACHE_LINE_64B=y

# ----- Host transport: native USB (vendor bulk + HID) -----
# I2C is on GPIO1/2, leaving GPIO19/20 (USB D+/D-) free.
CONFIG_TOUCHY_LOG_OVER_PROTO=y
```
